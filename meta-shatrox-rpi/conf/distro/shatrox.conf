## meta-shatrox-rpi/conf/distro/shatrox.conf
```bitbake
################################################################################
#
# SHATROX Yocto Project Customized Distro for Raspberry Pi
# Based on Yocto Project 5.0 Poky distribution [scarthgap] branch
#
################################################################################

require conf/distro/poky.conf

MAINTAINER               = "Sherif Mousa <sherif.e.mousa@gmail.com>"
DISTRO                   = "shatrox"
TARGET_VENDOR            = "-shatrox"
DISTRO_NAME              = "Shatrox (Yocto Project Customized Distro for Raspberry Pi)"
DISTRO_VERSION           = "5.0"
DISTRO_CODENAME          = "scarthgap"
```
